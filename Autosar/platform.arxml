AUTOSAR XML (schema 4-2-1)
standard types defined: boolean, float32, float64, sint8, sint16, sint32, uint8, uint16, uint32
