VERSION ""

NS_ :

BS_:

BU_: ECU_Rec_Warning ECU_SpeedDisplay ECU_Acc

BO_ 940 Waning_message: 1 Vector__XXX
 SG_ warning_Signal : 0|8@1- (1,0) [0|1] ""  ECU_Rec_Warning

BO_ 939 speed_message: 1 ECU_SpeedDisplay
 SG_ speed_signal : 0|8@1- (1,0) [0|255] ""  ECU_Acc

BO_ 48 ACC_message: 1 ECU_Acc
 SG_ ACC_signal : 0|8@1- (1,0) [0|1] ""  ECU_SpeedDisplay
